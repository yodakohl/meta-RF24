## conf/layer.conf
```bitbake
# We have a conf and classes directory, add to BBPATH
BBPATH .= ":${LAYERDIR}"

# We have recipes-* directories, add to BBFILES
BBFILES += "${LAYERDIR}/recipes-*/*/*.bb \
${LAYERDIR}/recipes-*/*/*.bbappend"

BBFILE_COLLECTIONS += "rf24"
BBFILE_PATTERN_rf24 = "^${LAYERDIR}/"
BBFILE_PRIORITY_rf24 = "9"

# This should only be incremented on significant changes that will
# cause compatibility issues with other layers
LAYERVERSION_rf24 = "1"

LAYERDEPENDS_rf24 = "core"
```
